## boards/shields/lynxware/Kconfig.defconfig
```kconfig
if SHIELD_LYNXWARE_CAT_RIGHT
    config SPI
        default y
    config ZMK_POINTING
        default y
endif

if SHIELD_LYNXWARE_CAT_DONGLE
    config ZMK_SPLIT_ROLE_CENTRAL
        default y
    config ZMK_POINTING
        default y
endif
```

## boards/shields/lynxware/Kconfig.shield
```kconfig
config SHIELD_LYNXWARE_CAT_LEFT
	def_bool $(shields_list_contains,lynxware_cat_left)

config SHIELD_LYNXWARE_CAT_RIGHT
	def_bool $(shields_list_contains,lynxware_cat_right)

config SHIELD_LYNXWARE_CAT_DONGLE
	def_bool $(shields_list_contains,lynxware_cat_dongle)
```

## config/west.yml
```yaml
manifest:
  remotes:
    - name: zmkfirmware
      url-base: https://github.com/zmkfirmware
    - name: badjeff
      url-base: https://github.com/badjeff
    - name: nrfconnect
      url-base: https://github.com/nrfconnect
    # Additional modules containing boards/shields/custom code can be listed here as well
    # See https://docs.zephyrproject.org/3.2.0/develop/west/manifest.html#projects
  projects:
    - name: zmk
      remote: zmkfirmware
      revision: main
      import: app/west.yml
    - name: zmk-pmw3610-driver
      remote: badjeff
      revision: main
    - name: zmk-behavior-mouse-key-toggle
      remote: badjeff
      revision: main
    - name: zmk-feature-split-esb
      remote: badjeff
      revision: main  
    - name: sdk-nrf
      remote: nrfconnect
      revision: v2.6.4 # zephyr v3.5.99
      path: nrf
    - name: nrfxlib
      remote: nrfconnect
      revision: v2.6.4
      repo-path: sdk-nrfxlib
      path: nrfxlib
  self:
    path: config
```
